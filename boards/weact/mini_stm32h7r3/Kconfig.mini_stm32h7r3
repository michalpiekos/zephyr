## boards/weact/mini_stm32h7r3/Kconfig.mini_stm32h7r3
```kconfig
# Copyright (c) 2025 Michal Piekos
# SPDX-License-Identifier: Apache-2.0

config BOARD_MINI_STM32H7R3
	select SOC_STM32H7R3XX
```

## boards/weact/mini_stm32h7r3/board.yml
```yaml
board:
  name: mini_stm32h7r3
  full_name: MiniSTM32H7R3 Core Board
  vendor: weact
  socs:
    - name: stm32h7r3xx
```
